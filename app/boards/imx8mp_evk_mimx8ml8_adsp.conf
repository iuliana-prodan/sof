## app/boards/imx8mp_evk_mimx8ml8_adsp.conf
```kconfig
CONFIG_IMX8M=y
CONFIG_IPC_MAJOR_4=y
CONFIG_HAVE_AGENT=n
CONFIG_FORMAT_CONVERT_HIFI3=n
CONFIG_KPB_FORCE_COPY_TYPE_NORMAL=n
CONFIG_ZEPHYR_LOG=y
CONFIG_LOG_BUFFER_SIZE=65536
```

## app/boards/nxp_adsp_imx8m.conf
```kconfig
CONFIG_IMX8M=y
CONFIG_IPC_MAJOR_4=y
CONFIG_HAVE_AGENT=n
CONFIG_FORMAT_CONVERT_HIFI3=n
CONFIG_KPB_FORCE_COPY_TYPE_NORMAL=n
```

## app/sample.yaml
```yaml
---
sample:
  description: Audio with SOF
  name: sof
common:
  tags: audio
  modules:
    - sof
tests:
  sample.audio.sof:
    tags: sof
    build_only: true
    platform_allow:
      - intel_adsp_cavs25
      - intel_adsp_ace15_mtpm
      - intel_adsp_ace20_lnl
      - imx8qm_mek/mimx8qm6/adsp
      - imx8qxp_mek/mimx8qx6/adsp
      - imx8mp_evk/mimx8ml8/adsp
      - imx8ulp_evk/imx8ulp/adsp

    integration_platforms:
      - intel_adsp_cavs25  # TGL
      - intel_adsp_ace15_mtpm  # MTL
      - intel_adsp_ace20_lnl
      - imx8qm_mek/mimx8qm6/adsp
      - imx8qxp_mek/mimx8qx6/adsp
      - imx8mp_evk/mimx8ml8/adsp
      - imx8ulp_evk/imx8ulp/adsp
```
